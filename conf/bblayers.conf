## conf/bblayers.conf
```bitbake
# POKY_BBLAYERS_CONF_VERSION is increased each time build/conf/bblayers.conf
# changes incompatibly
POKY_BBLAYERS_CONF_VERSION = "2"

BBPATH = "${TOPDIR}"
BBFILES ?= ""

BBLAYERS ?= " \
  /usr1/openeuler/src/yocto-poky/meta \
  /usr1/openeuler/src/yocto-poky/../yocto-meta-openembedded/meta-oe \
  /usr1/openeuler/src/yocto-poky/../yocto-meta-openembedded/meta-python \
  /usr1/openeuler/src/yocto-poky/../yocto-meta-openembedded/meta-networking \
  /usr1/openeuler/src/yocto-poky/../yocto-meta-openembedded/meta-filesystems \
  /usr1/openeuler/src/yocto-poky/../yocto-meta-openeuler/meta-openeuler \
  /usr1/openeuler/src/yocto-poky/../yocto-meta-openeuler/bsp/meta-openeuler-bsp \
  "
```
